## Kconfig
```kconfig
#
# For a description of the syntax of this configuration file,
# see the file kconfig-language.txt in the NuttX tools repository.
#

config EXTERNAL_NGHTTP2
	bool "NGHTTP2 library"
	default n
	---help---
		Enables the NGHTTP2 library.
```
